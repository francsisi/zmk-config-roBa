## config/west.yml
```yaml
manifest:
  remotes:
    - name: zmkfirmware
      url-base: https://github.com/zmkfirmware
    - name: kumamuk-git
      url-base: https://github.com/kumamuk-git
    - name: prospector
      url-base: https://github.com/t-ogura
    # https://note.com/wataru_7/n/nf2d38c516485
    # FOR　RGB
    - name: caksoylar
      url-base: https://github.com/caksoylar      
  projects:
    - name: zmk
      remote: zmkfirmware
      revision: v0.3-branch
      import: app/west.yml
    #　FOR　RGB 
    - name: zmk-rgbled-widget
      remote: caksoylar      
    - name: zmk-pmw3610-driver
      remote: kumamuk-git
      revision: main
    - name: prospector-zmk-module
      remote: prospector
      revision: v1.0.0
      path: modules/prospector-zmk-module      
  self:
    path: config
```
